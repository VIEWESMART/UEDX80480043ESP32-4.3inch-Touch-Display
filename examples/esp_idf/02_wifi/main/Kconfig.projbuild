## examples/esp_idf/02_wifi/main/Kconfig.projbuild
```kconfig
menu "Example Configuration"

    config EXAMPLE_WIFI_SSID
        string "WiFi SSID"
        default "myssid"
        help
            要连接的 2.4 GHz Wi-Fi 名称。也可直接改本目录 sdkconfig.defaults。

    config EXAMPLE_WIFI_PASSWORD
        string "WiFi Password"
        default "mypassword"
        help
            Wi-Fi 密码。开放网络可留空后在 sdkconfig 里把该项改成空字符串。

endmenu
```

## examples/esp_idf/06_album/main/Kconfig.projbuild
```kconfig
menu "Example Configuration"

    config EXAMPLE_ALBUM_DIR
        string "Album folder on SD (empty = root)"
        default "album"
        help
            Relative to /sdcard. If the folder is missing or empty, the SD root is scanned.

    config EXAMPLE_ALBUM_INTERVAL_MS
        int "Slideshow interval (ms), 0 = off"
        default 5000
        range 0 60000

endmenu
```
